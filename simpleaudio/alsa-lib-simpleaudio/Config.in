## simpleaudio/alsa-lib-simpleaudio/Config.in
```kconfig
config BR2_PACKAGE_ALSA_LIB_SIMPLEAUDIO
	bool "Enable Simpleaudio ALSA-lib"
	help
	  This enables a custimized ALSA-lib implemented to work with the Simpleaudio Roomplayer+ soundcard.
```

## simpleaudio/alsa-utils-simpleaudio/Config.in
```kconfig
config BR2_PACKAGE_ALSA_UTILS_SIMPLEAUDIO
	bool "Enable Simpleaudio ALSA-Utils"
	help
	  This enables a custimized ALSA-Utils implemented to work with the Simpleaudio Roomplayer+ soundcard.
```

## simpleaudio/gpio-simpleaudio/Config.in
```kconfig
config BR2_PACKAGE_GPIO_SIMPLEAUDIO
	bool "Simpleaudio GPIO tools"
	help
	  Adds help tools to read and write the GPIO as in the original software.
```

## simpleaudio/init-gpio-simpleaudio/Config.in
```kconfig
config BR2_PACKAGE_INIT_GPIO_SIMPLEAUDIO
	bool "Initilize GPIO at boot"
	help
	  Service and script which initilizes the GPIO at boot.
```
